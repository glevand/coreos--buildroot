## configs/dockerbox_arm64_defconfig
```kconfig
BR2_aarch64=y
BR2_PACKAGE_HOST_LINUX_HEADERS_CUSTOM_4_4=y
BR2_TARGET_GENERIC_GETTY_PORT="ttyAMA0"
BR2_SYSTEM_DHCP="eth0"
BR2_LINUX_KERNEL=y
BR2_LINUX_KERNEL_CUSTOM_VERSION=y
BR2_LINUX_KERNEL_CUSTOM_VERSION_VALUE="4.4.1"
BR2_LINUX_KERNEL_USE_CUSTOM_CONFIG=y
BR2_LINUX_KERNEL_CUSTOM_CONFIG_FILE="board/qemu/aarch64-virt/linux-4.4.config"
BR2_TARGET_ROOTFS_INITRAMFS=y
# BR2_TARGET_ROOTFS_TAR is not set
```

## configs/flannelbox_arm64_defconfig
```kconfig
BR2_aarch64=y
BR2_CCACHE=y
BR2_OPTIMIZE_2=y
BR2_GCC_VERSION_4_8_X=y
BR2_ENABLE_LOCALE_PURGE=y
BR2_ENABLE_LOCALE_WHITELIST="C en_US"
BR2_TARGET_OPTIMIZATION="-pipe"
BR2_TARGET_GENERIC_HOSTNAME="flannelbox"
BR2_TARGET_GENERIC_ISSUE=""
BR2_INIT_NONE=y
BR2_TARGET_GENERIC_GETTY_PORT="ttyAMA0"
BR2_TARGET_GENERIC_GETTY_BAUDRATE_115200=y
BR2_SYSTEM_DHCP="eth0"
BR2_PACKAGE_BUSYBOX_SHOW_OTHERS=y
BR2_PACKAGE_CA_CERTIFICATES=y
BR2_PACKAGE_OPENSSL=y
BR2_PACKAGE_READLINE=y
BR2_PACKAGE_FLANNEL=y
BR2_PACKAGE_IPROUTE2=y
BR2_PACKAGE_IPTABLES=y
BR2_TARGET_ROOTFS_EXT2=y
BR2_TARGET_ROOTFS_EXT2_2r1=y
BR2_TARGET_ROOTFS_EXT2_LABEL="ROOT"
```

## package/flannel/Config.in
```kconfig
comment "flannel needs a toolchain w/ threads"
	depends on BR2_PACKAGE_HOST_GO_ARCH_SUPPORTS
	depends on !BR2_TOOLCHAIN_HAS_THREADS

# cgo on ARM requires PIE linkage, which is not compatable with uClibc.
comment "flannel is not available with uClibc-based toolchain on ARM architecture"
	depends on BR2_PACKAGE_HOST_GO_ARCH_SUPPORTS
	depends on BR2_TOOLCHAIN_HAS_THREADS
	depends on BR2_arm && BR2_TOOLCHAIN_USES_UCLIBC

config BR2_PACKAGE_FLANNEL
	bool "flannel"
	depends on BR2_PACKAGE_HOST_GO_ARCH_SUPPORTS
	depends on BR2_TOOLCHAIN_HAS_THREADS
	depends on !(BR2_arm && BR2_TOOLCHAIN_USES_UCLIBC)
	help
	  Flannel is a virtual network that gives a subnet to each
	  host for use with container runtimes.

	  https://github.com/coreos/flannel
```

## package/go-sample/Config.in
```kconfig
config BR2_PACKAGE_GO_SAMPLE
	bool "go-sample"
	depends on BR2_PACKAGE_HOST_GO_ARCH_SUPPORTS
	help
	  A test go program that does not use cgo.
```
